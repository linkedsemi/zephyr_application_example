## boards/arm/custom_plank/Kconfig.board
```kconfig
# SPDX-License-Identifier: Apache-2.0

config BOARD_CUSTOM_PLANK
	bool "Custom Plank Board"
	depends on SOC_LE5010
```

## boards/arm/custom_plank/custom_plank_defconfig
```kconfig
# Copyright (c) 2023 Linkedsemi
# SPDX-License-Identifier: Apache-2.0

CONFIG_SOC_LE5010=y
CONFIG_SOC_SERIES_LE501X=y
CONFIG_BOARD_CUSTOM_PLANK=y

CONFIG_SYS_CLOCK_HW_CYCLES_PER_SEC=2000000
CONFIG_USE_SEGGER_RTT=y
CONFIG_MINIMAL_LIBC=y
CONFIG_MINIMAL_LIBC_RAND=y

CONFIG_GPIO=y

CONFIG_PINCTRL=y

# Power Management
CONFIG_PM=y
CONFIG_PM_DEVICE=y
CONFIG_PM_POLICY_CUSTOM=y
```

## west.yml
```yaml
# Copyright (c) 2021 Nordic Semiconductor ASA
# SPDX-License-Identifier: Apache-2.0

manifest:
  self:
    west-commands: scripts/west-commands.yml

  remotes:
    - name: linkedsemi
      url-base: https://github.com/linkedsemi

  projects:
    - name: zephyr
      remote: linkedsemi
      revision: zephyr-v3.5.0-linkedsemi
      import:
        # By using name-allowlist we can clone only the modules that are
        # strictly needed by the application.
        name-allowlist:
          - cmsis      # required by the ARM port
          - segger     # required by the flashing
          - tinycrypt  # required by the BLE crypto
          - hal_linkedsemi     # required by the custom_plank board
```
