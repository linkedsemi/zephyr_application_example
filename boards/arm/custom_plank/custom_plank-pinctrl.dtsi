/*
 * Copyright (c) 2022 Nordic Semiconductor ASA
 * SPDX-License-Identifier: Apache-2.0
 */
#include <zephyr/dt-bindings/pinctrl/ls-pinctrl.h>

&pinctrl {
    /* UART1 */
	/omit-if-no-ref/uart1_tx_pb00: uart1_tx_pb00 {
		pinmux = <LS_PINMUX_SET('B', 00, AF_UART1_TXD)>;
        output-enable;
        output-high;

	};
	/omit-if-no-ref/uart1_rx_pb01: uart1_rx_pb01 {
		pinmux = <LS_PINMUX_SET('B', 01, AF_UART1_RXD)>;
        bias-pull-up;
		input-enable;
	};

};
